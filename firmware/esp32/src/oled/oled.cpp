#include "oled.h"
#include "esp_log.h"
#include "driver/i2c.h"
#include <cstring>
//ZIZI
namespace oled {

static const char* TAG = "OLED";

// Configuration SSD1306
static constexpr uint8_t SSD1306_ADDR = 0x3C;  // Adresse I2C standard
static constexpr uint8_t WIDTH = 128;
static constexpr uint8_t HEIGHT = 64;
static constexpr uint8_t PAGES = HEIGHT / 8;

// Buffer d'affichage
static uint8_t s_buffer[WIDTH * PAGES] = {0};
static i2c_port_t s_i2c_port = I2C_NUM_0;
static bool s_initialized = false;

// Police 5x7 simple (ASCII 32-127)
static const uint8_t FONT_5X7[][5] = {
    {0x00, 0x00, 0x00, 0x00, 0x00}, // ' '
    {0x00, 0x00, 0x5F, 0x00, 0x00}, // '!'
    {0x00, 0x07, 0x00, 0x07, 0x00}, // '"'
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    {0x02, 0x01, 0x02, 0x04, 0x02}, // '~'
};

// Commandes SSD1306
enum Cmd {
    SET_CONTRAST = 0x81,
    DISPLAY_ALL_ON_RESUME = 0xA4,
    DISPLAY_ALL_ON = 0xA5,
    NORMAL_DISPLAY = 0xA6,
    INVERT_DISPLAY = 0xA7,
    DISPLAY_OFF = 0xAE,
    DISPLAY_ON = 0xAF,
    SET_DISPLAY_OFFSET = 0xD3,
    SET_COM_PINS = 0xDA,
    SET_VCOM_DETECT = 0xDB,
    SET_DISPLAY_CLOCK_DIV = 0xD5,
    SET_PRECHARGE = 0xD9,
    SET_MULTIPLEX = 0xA8,
    SET_LOW_COLUMN = 0x00,
    SET_HIGH_COLUMN = 0x10,
    SET_START_LINE = 0x40,
    MEMORY_MODE = 0x20,
    COLUMN_ADDR = 0x21,
    PAGE_ADDR = 0x22,
    COM_SCAN_INC = 0xC0,
    COM_SCAN_DEC = 0xC8,
    SEG_REMAP = 0xA0,
    CHARGE_PUMP = 0x8D,
    EXTERNAL_VCC = 0x01,
    SWITCH_CAP_VCC = 0x02,
};

// Envoie une commande
static esp_err_t send_command(uint8_t cmd) {
    uint8_t data[2] = {0x00, cmd};  // 0x00 = Co=0, D/C=0 (command)
    return i2c_master_write_to_device(s_i2c_port, SSD1306_ADDR, data, 2, pdMS_TO_TICKS(100));
}

// Envoie des données
static esp_err_t send_data(const uint8_t* data, size_t len) {
    uint8_t* buffer = new uint8_t[len + 1];
    buffer[0] = 0x40;  // 0x40 = Co=0, D/C=1 (data)
    memcpy(buffer + 1, data, len);
    esp_err_t ret = i2c_master_write_to_device(s_i2c_port, SSD1306_ADDR, buffer, len + 1, pdMS_TO_TICKS(100));
    delete[] buffer;
    return ret;
}

bool init(int scl_gpio, int sda_gpio, uint32_t i2c_freq) {
    ESP_LOGI(TAG, "Initialisation OLED SSD1306...");
    ESP_LOGI(TAG, "  SCL: GPIO%d", scl_gpio);
    ESP_LOGI(TAG, "  SDA: GPIO%d", sda_gpio);
    ESP_LOGI(TAG, "  Freq: %lu Hz", i2c_freq);

    // Configuration I2C
    i2c_config_t conf = {};
    conf.mode = I2C_MODE_MASTER;
    conf.sda_io_num = sda_gpio;
    conf.scl_io_num = scl_gpio;
    conf.sda_pullup_en = GPIO_PULLUP_ENABLE;
    conf.scl_pullup_en = GPIO_PULLUP_ENABLE;
    conf.master.clk_speed = i2c_freq;

    esp_err_t ret = i2c_param_config(s_i2c_port, &conf);
    if (ret != ESP_OK) {
        ESP_LOGE(TAG, "Échec configuration I2C: %s", esp_err_to_name(ret));
        return false;
    }

    ret = i2c_driver_install(s_i2c_port, conf.mode, 0, 0, 0);
    if (ret != ESP_OK) {
        ESP_LOGE(TAG, "Échec installation driver I2C: %s", esp_err_to_name(ret));
        return false;
    }

    // Séquence d'initialisation SSD1306
    vTaskDelay(pdMS_TO_TICKS(100));  // Attente stabilisation

    send_command(DISPLAY_OFF);
    send_command(SET_DISPLAY_CLOCK_DIV);
    send_command(0x80);
    send_command(SET_MULTIPLEX);
    send_command(HEIGHT - 1);
    send_command(SET_DISPLAY_OFFSET);
    send_command(0x00);
    send_command(SET_START_LINE | 0x00);
    send_command(CHARGE_PUMP);
    send_command(0x14);  // Enable charge pump
    send_command(MEMORY_MODE);
    send_command(0x00);  // Horizontal addressing mode
    send_command(SEG_REMAP | 0x01);
    send_command(COM_SCAN_DEC);
    send_command(SET_COM_PINS);
    send_command(0x12);
    send_command(SET_CONTRAST);
    send_command(0xCF);
    send_command(SET_PRECHARGE);
    send_command(0xF1);
    send_command(SET_VCOM_DETECT);
    send_command(0x40);
    send_command(DISPLAY_ALL_ON_RESUME);
    send_command(NORMAL_DISPLAY);
    send_command(DISPLAY_ON);

    clear();
    update();

    s_initialized = true;
    ESP_LOGI(TAG, "✓ OLED initialisé (128x64)");
    return true;
}

void clear() {
    if (!s_initialized) return;
    memset(s_buffer, 0, sizeof(s_buffer));
}

void print(const char* text, uint8_t x, uint8_t y) {
    if (!s_initialized || text == nullptr) return;
    if (y >= PAGES) return;

    size_t len = strlen(text);
    for (size_t i = 0; i < len && x < WIDTH; i++) {
        char c = text[i];
        if (c < 32 || c > 126) c = 32;  // Caractères non imprimables -> espace

        const uint8_t* glyph = FONT_5X7[c - 32];
        for (int col = 0; col < 5 && x < WIDTH; col++) {
            s_buffer[y * WIDTH + x] = glyph[col];
            x++;
        }
        
        // Espace entre caractères
        if (x < WIDTH) {
            s_buffer[y * WIDTH + x] = 0x00;
            x++;
        }
    }
}

void update() {
    if (!s_initialized) return;

    send_command(COLUMN_ADDR);
    send_command(0);
    send_command(WIDTH - 1);
    send_command(PAGE_ADDR);
    send_command(0);
    send_command(PAGES - 1);

    send_data(s_buffer, sizeof(s_buffer));
}

void set_contrast(uint8_t contrast) {
    if (!s_initialized) return;
    send_command(SET_CONTRAST);
    send_command(contrast);
}

void power(bool on) {
    if (!s_initialized) return;
    send_command(on ? DISPLAY_ON : DISPLAY_OFF);
}

} // namespace oled
